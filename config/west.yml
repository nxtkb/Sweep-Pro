## config/west.yml
```yaml
manifest:
  remotes:
  - name: zmkfirmware
    url-base: https://github.com/zmkfirmware
  - name: lynnlee0522
    url-base: https://github.com/lynnlee0522
  - name: nxtkb
    url-base: https://github.com/nxtkb
  projects:
  - name: zmk
    remote: nxtkb
    revision: b66b8b4e07655d16c01d14bfa06e2f7f6c46025f
    import: app/west.yml
  - name: zmk-vfx-sweep-pro-display
    remote: nxtkb
    revision: 578352fd5136bb5e3eafc6dc0cb00ae7ae5e705d
  - name: zmk-feature-codex-micro
    remote: nxtkb
    revision: cb08948c527a206f02b9ca7a567bc2437ccd4970
  - name: zmk-behavior-report
    remote: nxtkb
    revision: 476f43da1f98b4a6150c9c0e499a257bd64a29a0
    import: west.yml
  - name: cirque-input-module
    remote: nxtkb
    revision: 8af03a4c061580c14ec8745caf0fa2dd3fc7f042
  self:
    path: config
```
