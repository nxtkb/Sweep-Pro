#include <dt-bindings/nxtkb/hardware-discovery.h>

/ {
    hardware_trackpad {
        compatible = "nxtkb,hardware-component";
        component-id = <4>;
        component-kind = <NXTKB_HW_TRACKPAD>;
        side = <NXTKB_HW_SIDE_RIGHT>;
        remote;
        split-source = <0>;
    };
};
