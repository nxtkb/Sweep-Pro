## boards/shields/sweep/Kconfig.defconfig
```kconfig
if SHIELD_SWEEP_LEFT
# Name must be less than 16 characters long!
config ZMK_KEYBOARD_NAME
    default "Sweep Pro"

config ZMK_SPLIT_ROLE_CENTRAL
    default y

endif 


if SHIELD_SWEEP_LEFT || SHIELD_SWEEP_RIGHT || SHIELD_SWEEP_LEFT_DISPLAY_HW || SHIELD_SWEEP_LEFT_TPS65 || SHIELD_SWEEP_RIGHT_TPS65
config ZMK_SPLIT
    default y
endif
```

## boards/shields/sweep/Kconfig.shield
```kconfig
# No whitespace after the comma or in your part name!
config SHIELD_SWEEP_LEFT
    def_bool $(shields_list_contains,sweep_left)

config SHIELD_SWEEP_LEFT_DISPLAY_HW
    def_bool $(shields_list_contains,sweep_left_display_hw)

config SHIELD_SWEEP_LEFT_TPS65
    def_bool $(shields_list_contains,sweep_left_tps65)

# No whitespace after the comma or in your part name!
config SHIELD_SWEEP_RIGHT
    def_bool $(shields_list_contains,sweep_right)

config SHIELD_SWEEP_RIGHT_TPS65
    def_bool $(shields_list_contains,sweep_right_tps65)
```
